## kangaroo-meme-box/main/Kconfig.projbuild
```kconfig
menu "袋鼠整活盒 (Kangaroo Meme Box)"

    config OLED_SDA_GPIO
        int "OLED SDA 引脚 (I2C)"
        range 0 48
        default 8
        help
            ESP32-S2 的 I2C 可以任意映射引脚。GPIO26~32 被 Flash/PSRAM 占用，
            GPIO45/46 是 strapping 引脚，都不要用。

    config OLED_SCL_GPIO
        int "OLED SCL 引脚 (I2C)"
        range 0 48
        default 9

    config OLED_I2C_ADDR
        hex "OLED I2C 地址 (7位)"
        default 0x3C
        help
            常见 0.96/1.3 寸 SSD1306 模块默认是 0x3C；
            背面有个 0x78/0x7A 的焊盘电阻，跳到另一边就变成 0x3D。

    config BUZZER_GPIO
        int "蜂鸣器控制引脚"
        range 0 48
        default 4
        help
            有源蜂鸣器，高电平触发：GPIO 输出 1 就响。
            当前硬件接在 GPIO4 上。
            建议用三极管/MOS 驱动，别让 GPIO 直接带大电流蜂鸣器。

    config BUTTON_GPIO
        int "触发按键引脚"
        range 0 48
        default 0
        help
            默认 GPIO0 = 开发板上的 BOOT 键，按下为低电平。
            长按 1.2 秒切换静音，短按切换台词。

    config FRAME_INTERVAL_MS
        int "刷新间隔 (ms)"
        range 20 200
        default 40
        help
            40ms ≈ 25fps。I2C 400kHz 传一屏约 23ms，
            想更流畅可以把 I2C 提到 800kHz 并把这个值改小。

    config IDLE_AUTOSHOW_SEC
        int "待机自动播放间隔 (秒)"
        range 0 600
        default 10
        help
            待机时每 N 秒自动来一句台词；填 0 则只靠按键触发。

endmenu
```

## kangaroo-meme-box/sdkconfig.defaults
```kconfig
# ===== ESP32-S2-DevKitC-1-N8R2 =====
CONFIG_IDF_TARGET="esp32s2"

# N8 = 8MB Flash（R2 = 2MB PSRAM，本工程不用，保持默认关闭即可）
CONFIG_ESPTOOLPY_FLASHSIZE_8MB=y
CONFIG_ESPTOOLPY_FLASHSIZE="8MB"

# 单核 240MHz：动画 + 刷屏都吃 CPU，直接拉满
CONFIG_ESP_DEFAULT_CPU_FREQ_MHZ_240=y

# 主任务栈：帧缓冲和刷屏缓冲都是静态的，这里给 8K 是给日志和浮点运算留余量
CONFIG_ESP_MAIN_TASK_STACK_SIZE=8192

# FreeRTOS 节拍 1000Hz，vTaskDelay(40) 才能精确到 40ms
CONFIG_FREERTOS_HZ=1000

# 日志级别：INFO 能看清初始化过程和按键事件
CONFIG_LOG_DEFAULT_LEVEL_INFO=y
CONFIG_LOG_MAXIMUM_LEVEL_INFO=y

# ---------------------------------------------------------------------------
# 想进一步压缩固件（8MB Flash 其实完全不缺空间）可以打开下面这些，
# 如果编译报某组件缺失，把对应行删掉即可：
#
#   CONFIG_BT_ENABLED=n             # ESP32-S2 本来就没有蓝牙
#   CONFIG_ESP_WIFI_ENABLED=n       # 本项目不联网
#   CONFIG_OPENTHREAD_ENABLED=n
# ---------------------------------------------------------------------------
```
